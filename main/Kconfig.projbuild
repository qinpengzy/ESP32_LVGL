## main/Kconfig.projbuild
```kconfig
menu "Example Configuration"

    config BROKER_URL
        string "Broker URL"
        default "mqtt://mqtt.eclipseprojects.io"
        help
            URL of the broker to connect to

    config BROKER_URL_FROM_STDIN
        bool
        default y if BROKER_URL = "FROM_STDIN"
    
    config MQTT_USERNAME
        string "MQTT username"
        default "mqttusername"
        help
            MQTT username.
    
    config MQTT_PASSWORD
        string "MQTT password"
        default "mqttpassword"
        help
            MQTT password.
    
    config MQTT_SERVER_PORT
        int "MQTT server port"
        default 1883
        help
            MQTT server port number.

    config MQTT_CLIENT_ID
        string "MQTT Client ID"
        default "myclientid"
        help
            MQTT server Client ID.
    
    config WIFI_SSID
        string "WiFi SSID"
        default "myssid"
        help
            SSID (network name) for the example to connect to.
    
    config WIFI_PASSWORD
        string "WiFi Password"
        default "mypassword"
        help
            WiFi password (WPA or WPA2) for the example to use.

endmenu
```
